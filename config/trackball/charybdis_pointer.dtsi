#include <input/processors.dtsi>
#include <dt-bindings/zmk/input_transform.h>
#include <zephyr/dt-bindings/input/input-event-codes.h>

#define RAISE 2
#define NAV   3

&trackball_listener {
    /* base processor chain on all layers */
    input-processors = <&zip_xy_scaler 5 5>;

    /* layer-3 scroll override */
    scroller: scroller {
        layers           = <RAISE>;
        input-processors = <
            &zip_xy_scaler 1 15                              // Scales the scroll speed
            &zip_xy_to_scroll_mapper                         // Converts XY movement to scroll events
            &zip_scroll_transform (INPUT_TRANSFORM_Y_INVERT) // Inverts the scroll direction
        >;
    };

    /* layer-4 slow-pointer override */
    slow_pointer: slow_pointer {
        layers           = <NAV>;
        input-processors = <&zip_xy_scaler 1 5>;
    };
};
